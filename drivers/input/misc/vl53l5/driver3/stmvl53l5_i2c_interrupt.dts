/dts-v1/;
/plugin/;

/ {
    compatible = "brcm,bcm2835";

    fragment@0 {
        target = <&i2c1>;

        __overlay__ {
            status = "okay";
            #address-cells = <1>;
            #size-cells = <0>;

            stmvl53l5: stmvl53l5 {
                compatible = "st,stmvl53l5";
                reg = <0x29>;
                status = "okay";
                stm,interrupt = <&gpio 16 1>; /* This is only required if interrupt pin is unhandled on platform */
                stm,firmware_name = "stmvl53l5.bin";
            };
        };
    };

};
