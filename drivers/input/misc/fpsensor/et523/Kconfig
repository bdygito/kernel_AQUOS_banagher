## drivers/input/misc/fpsensor/et523/Kconfig
```kconfig
#
# Sensor  drivers configuration
#

menu "SENSORS_FPRINT_EGIS_ET523"

config SENSORS_FPRINT_ET523_PLATFORM
	bool "Egis fingerprint sensor ET523 platform support"
	default n
	help
	  If you say yes here you get support for the platform of the egis fingerprint sensor.

config SENSORS_FPRINT_SHARP_CUSTOMIZE
	bool "fingerprint sensor enable sharp customize"
	default n
	help
	  If you say yes here you can enable Sharp customize.

config SENSORS_FPRINT_NAVI_INPUT
	bool "fingerprint sensor enable navi input"
	default n
	help
	  If you say yes here you can enable navi input.

config SENSORS_FPRINT_ET523_MODULE
    tristate "fingerprint sensor enable loadable kernel module ET523"
    default n
    help
      If you say yes here you can enable loadable kernel module.

config SENSORS_FPRINT_LDO_CTRL
    bool "fingerprint sensor enable power control for external LDO"
    default n
    help
      If you say yes here you can enable power control for external LDO.

endmenu
```

## drivers/input/misc/fpsensor/et713/Kconfig
```kconfig
#
# Sensor  drivers configuration
#

menu "SENSORS_FPRINT_EGIS_ET713"

config SENSORS_FPRINT_ET713_MODULE
	tristate "fingerprint sensor enable loadable kernel module ET713"
	default n
	help
	  If you say yes here you can enable loadable kernel module.

config SENSORS_FPRINT_ET713_PLATFORM
	bool "EGIS fingerprint sensor platform support"
	default n
	help
	  If you say yes here you get support for the platform of the egis fingerprint sensor.

config SENSORS_FPRINT_SHARP_CUSTOMIZE
	bool "fingerprint sensor enable sharp customize"
	default n
	help
	  If you say yes here you can enable Sharp customize.

config SENSORS_FPRINT_SHARP_PRE_EVT
	bool "Correspondence required for PreEVT of fingerprint sensor"
	default n
	help
	  If you say yes here you can enable Sharp customize for PreEVT.

config SENSORS_FPRINT_SHARP_EGIS_NAVIGATION_SUPPORT
	bool "Egis fingerprint navigation support"
	default n
	help
	  If you say yes here you can enable Egis navigation.

endmenu
```

## drivers/input/touchscreen/shtps/Kconfig
```kconfig
#
# Sharp Touchscreen configuration
#

menu "SHARP TPS driver"

comment "SHARP Touchscreen device drivers"

config TOUCHSCREEN_SHARP_TPS
	bool "SHARP Touchscreens"
	default n

if TOUCHSCREEN_SHARP_TPS
	source "drivers/input/touchscreen/shtps/sy3000/Kconfig"

	config SHARP_TPS_FOCALTECH_DEV
		tristate "Focaltech Device"
		default n
		depends on TOUCHSCREEN_SHARP_TPS

	source "drivers/input/touchscreen/shtps/focaltech/Kconfig"
	source "drivers/input/touchscreen/shtps/focaltech_ft3519/Kconfig"

endif # TOUCHSCREEN_SHARP_TPS
endmenu
```

## drivers/input/touchscreen/shtps/focaltech/Kconfig
```kconfig
#
# Sharp Touchscreen configuration
#

if SHARP_TPS_FOCALTECH_DEV

	config SHARP_TPS_FOCALTECH_FT8707
		tristate "FOCALTECH FT8707"
		default n
		depends on SHARP_TPS_FOCALTECH_DEV

endif # SHARP_TPS_FOCALTECH_DEV
```

## drivers/input/touchscreen/shtps/focaltech_ft3519/Kconfig
```kconfig
#
# Sharp Touchscreen configuration
#

if SHARP_TPS_FOCALTECH_DEV

	config SHARP_TPS_FOCALTECH_FT3519
		tristate "FOCALTECH FT3519"
		default n
		depends on SHARP_TPS_FOCALTECH_DEV

endif # SHARP_TPS_FOCALTECH_DEV
```

## drivers/input/touchscreen/st/Kconfig
```kconfig
#
# STMicroelectronics touchscreen driver configuration
#

config TOUCHSCREEN_ST
      bool "STMicroelectronics Touchscreen Driver"
      default n
      depends on I2C
      help
        Say Y here if you have a STMicroelectronics Touchscreen.
        If unsure, say N.
```

## drivers/misc/shsensor_hub/Kconfig
```kconfig
#
# SensorHub drivers configuration
#

menu "SHARP ML630Q790 devices"

config SHUB_ML630Q790
	bool "LAPIS Semicomductor ML610Q790 SensorHub Micom for all"
	default y
	help
	 --- help ---
	 If you say yes here you get support for SHUB_ML630Q790.

config SHUB_ML630Q790_Banagher
	bool "LAPIS Semicomductor ML610Q790 SensorHub Micom for SM8250"
	depends on SHUB_ML630Q790
	default n
	help
	 --- help ---
	 If you say yes here you get support for SHUB_ML630Q790.

config SHUB_ML630Q790_Sarah
	bool "LAPIS Semicomductor ML610Q790 SensorHub Micom for SM6350"
	depends on SHUB_ML630Q790
	default n
	help
	 --- help ---
	 If you say yes here you get support for SHUB_ML630Q790.

config SHUB_ML630Q790_Recoa
	bool "LAPIS Semicomductor ML610Q790 SensorHub Micom for SM7225"
	depends on SHUB_ML630Q790
	default n
	help
	 --- help ---
	 If you say yes here you get support for SHUB_ML630Q790.

endmenu
```

## drivers/soc/qcom/sharp/Kconfig
```kconfig
#
# SHARP configuration
#

menu "SHARP Device Drivers for Qualcomm SOC"

comment "SHARP Device Drivers for Qualcomm SOC"

source "drivers/soc/qcom/sharp/shtimer/Kconfig"

source "drivers/soc/qcom/sharp/Kconfig.shrlog"

source "drivers/soc/qcom/sharp/shboot/Kconfig"

source "drivers/soc/qcom/sharp/pnp/Kconfig"

endmenu

menu "SHARP SHDIAG SMEM driver"

comment "SHARP SHDIAG SMEM driver"

config SHARP_SHDIAG_SMD
       tristate "SHARP SHDIAG SMEM DRIVER"
       depends on SHARP_SMEM_CUST
       default n
endmenu
```

## drivers/soc/qcom/sharp/Kconfig.shrlog
```kconfig
#
# SHARP configuration
#

config SHARP_SHLOG
	tristate "SHARP SHLOG driver base system."
	default n
	help
	  SHARP SHLOG driver base system.

config SHARP_SHLOG_RAMOOPS
	bool "Enable SHARP SHLOG for ramoops."
	depends on SHARP_SHLOG
	default n
	help
	  Enable SHARP SHLOG for ramoops.

config SHARP_SHLOG_TASKLIST
	bool "Enable SHARP SHLOG for tasks."
	depends on SHARP_SHLOG
	default n
	help
	  Enable SHARP SHLOG for tasks.

config SHARP_SHLOG_LATESTSTACK
	bool "Enable SHARP SHLOG for tasks of latest process."
	depends on SHARP_SHLOG
	default n
	help
	  Enable SHARP SHLOG for tasks of latest process.

config SHARP_HANDLE_PANIC
	bool "Enable SHARP handler for panic."
	depends on SHARP_SHLOG
	default n
	help
	  Enable SHARP handler for panic.

config SHARP_HANDLE_SURFACE_FLINGER
	bool "Enable SHARP handler for reset of surfaceflinger."
	depends on SHARP_HANDLE_PANIC
	default n
	help
	  Enable SHARP handler for reset of surfaceflinger.

config SHARP_HANDLE_DLOAD
	bool "Enable SHARP handler for dload."
	depends on SHARP_SHLOG
	default n
	help
	  Enable SHARP handler for dload.

config SHARP_HANDLE_DLOAD_MINIDEFAULT
	bool "Set default of dload to mini."
	depends on SHARP_HANDLE_DLOAD
	default n
	help
	  Enable Set default of dload to mini.

config SHARP_SHLOG_FORCEWARM_OVERRIDE
	bool "Override force-warm for shrlog."
	depends on SHARP_SHLOG
	default n
	help
	  Override force-warm for shrlog.

config SHARP_SHLOG_DLOADTYPE_MINI_OVERRIDE
	bool "Set default of dload to mini in module."
	depends on SHARP_SHLOG
	default n
	help
	  Enable Set default of dload to mini in module.

config SHARP_PANIC_ON_PWRKEY
	bool "Enable SHARP handler to call panic when powerkey pressed."
	depends on SHARP_SHLOG
	default n
	help
	  Enable SHARP handler to call panic when powerkey pressed.

config SHARP_PANIC_ON_PWRKEY_TIMEOUT
	int "Timeout to call panic when power-key is pressed."
	depends on SHARP_SHLOG
	default 4
	help
	  Timeout to call panic when power-key is pressed.

config SHARP_PANIC_ON_PWRKEY_TIMEOUT_VS
	int "Timeout to call panic when power-key is pressed."
	depends on SHARP_SHLOG
	default 4
	help
	  Timeout to call panic when power-key is pressed (S).

config SHARP_PANIC_ON_PWRKEY_TIMEOUT_MS
	int "Timeout to call panic when power-key is pressed, mseconds part"
	depends on SHARP_SHLOG
	default 0
	help
	  Timeout to call panic when power-key is pressed, mseconds part.

config SHARP_PANIC_ON_PWRKEY_TIMEOUT_MS_VS
	int "Timeout to call panic when power-key is pressed, mseconds part"
	depends on SHARP_SHLOG
	default 0
	help
	  Timeout to call panic when power-key is pressed, mseconds part (S).

config SHARP_SHLOG_SHOW_ABOOTLOG
	bool "Enable dumping aboot-log after boot."
	depends on SHARP_SHLOG
	default n
	help
	  Enable dumping aboot-log after boot.

config SHARP_SUPPORT_DLOAD_BOOTPARAM
	bool "Add parameter to set initial value for dload."
	default n
	help
	  Add parameter to set initial value for dload.
```
